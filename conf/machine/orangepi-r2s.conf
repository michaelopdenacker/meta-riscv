## conf/machine/orangepi-r2s.conf
```bitbake
#@TYPE: Machine
#@NAME: orangepi-r2s
#@SOC: Ky X1
#@DESCRIPTION: Machine configuration for OrangePi R2S

require conf/machine/include/riscv/tune-riscv.inc
require conf/machine/include/soc-family.inc

SOC_FAMILY = "k1"

KERNEL_DEVICETREE ?= "spacemit/k1-orangepi-r2s.dtb"

PREFERRED_PROVIDER_virtual/kernel ?= "linux-mainline"
PREFERRED_PROVIDER_virtual/bootloader ?= "u-boot-orangepi"

SERIAL_CONSOLES = "115200;ttyS0"

UBOOT_MACHINE = "x1_defconfig"
SPL_BINARY = "spl/u-boot-spl.bin"
UBOOT_ENV = "boot"
UBOOT_ENV_SUFFIX = "scr"

RISCV_SBI_PLAT = "generic"

KERNEL_CLASSES = "kernel"
KERNEL_IMAGETYPE = "Image"

EXTRA_IMAGEDEPENDS += "u-boot-orangepi"

IMAGE_BOOT_FILES += " \
	${UBOOT_ENV}.${UBOOT_ENV_SUFFIX} \
	${KERNEL_IMAGETYPE} \
	initramfs.img \
	x1_orangepi-r2s.dtb"

INITRAMFS_FSTYPES = "cpio.gz"
IMAGE_FSTYPES += "wic.gz wic.bmap ext4"

WKS_FILE ?= "orangepi-r2s-usb.wks"

WIC_CREATE_EXTRA_ARGS ?= "--no-fstab-update"

MACHINE_FEATURES = "screen keyboard ext2 ext3 serial"

MACHINE_EXTRA_RRECOMMENDS += "kernel-modules"
```
